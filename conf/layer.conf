## conf/layer.conf
```bitbake
# We have a conf and classes directory, append to BBPATH
BBPATH .= ":${LAYERDIR}"

# We have a recipes directory, add to BBFILES
BBFILES += "${LAYERDIR}/recipes*/*/*.bb ${LAYERDIR}/recipes*/*/*.bbappend"

BBFILE_COLLECTIONS += "meta-licheepizero"
BBFILE_PATTERN_meta-licheepizero := "^${LAYERDIR}/"
BBFILE_PRIORITY_meta-licheepizero = "10"
LAYERSERIES_COMPAT_meta-licheepizero = "dunfell"
```

## conf/machine/licheepizero-dock.conf
```bitbake
#@TYPE: Machine
#@NAME: LicheePi Zero
#@DESCRIPTION: Machine configuration for the LicheePi Zero plus dock, based on allwinner V3s CPU

require conf/machine/include/sun8i.inc

MACHINEOVERRIDES =. "sun8i"

PREFERRED_PROVIDER_virtual/xserver = "xserver-xorg"
XSERVER = "xserver-xorg \
           xf86-video-fbturbo \
           xf86-input-evdev \
           xf86-input-mouse \
           xf86-input-keyboard"
           
XSERVER += "sunxi-mali \
            sunxi-mali-dev"

PREFERRED_PROVIDER_virtual/bootloader = "u-boot"
PREFERRED_PROVIDER_u-boot-mainline = "2019.07"
UBOOT_MACHINE = "LicheePi_Zero_Dock_config"

PREFERRED_PROVIDER_virtual/kernel = "linux-mainline"
KERNEL_DEVICETREE = "sun8i-v3s-licheepi-zero-dock.dtb"

MACHINE_ESSENTIAL_EXTRA_RRECOMMENDS = " kernel-modules"
MACHINE_ESSENTIAL_EXTRA_RDEPENDS = "kernel-image kernel-devicetree"

IMAGE_FEATURES += "hwcodecs"

PREFERRED_VERSION_tslib = "1.21"
PREFERRED_VERSION_gdb = "9.1"

SERIAL_CONSOLES = "115200;ttyS0"
```

## conf/machine/licheepizero.conf
```bitbake
#@TYPE: Machine
#@NAME: Bananapi
#@DESCRIPTION: Machine configuration for the LicheePi Zero, based on allwinner V3s CPU

require conf/machine/include/sun8i.inc

MACHINEOVERRIDES =. "sun8i"

#PREFERRED_PROVIDER_virtual/xserver = "xserver-xorg"
#XSERVER = "xserver-xorg \
#           xf86-video-fbturbo \
#           xf86-input-evdev \
#           xf86-input-mouse \
#           xf86-input-keyboard"

PREFERRED_PROVIDER_virtual/bootloader = "u-boot-mainline"
PREFERRED_PROVIDER_u-boot-mainline = "2018.09"
UBOOT_MACHINE = "LicheePi_Zero_config"

PREFERRED_PROVIDER_virtual/kernel = "linux-mainline"
KERNEL_DEVICETREE = "sun8i-v3s-licheepi-zero.dtb"

MACHINE_ESSENTIAL_EXTRA_RRECOMMENDS = " kernel-modules"
MACHINE_ESSENTIAL_EXTRA_RDEPENDS = "kernel-image kernel-devicetree"

# remove pulseaudio since it brings in x11
DISTRO_FEATURES_BACKFILL_CONSIDERED += "pulseaudio opengl xcb wayland-egl xcomposite gl"

PACKAGECONFIG_remove_pn-xserver-xorg = "glamor"
#IMAGE_FEATURES += "x11"
#DISTRO_FEATURES_append = " opengl x11"
DISTRO_FEATURES_remove = "wayland"

PREFERRED_VERSION_tslib = "1.16"
PREFERRED_VERSION_gdb = "8.3.1"

SERIAL_CONSOLE = "115200 ttyGS0"
```
